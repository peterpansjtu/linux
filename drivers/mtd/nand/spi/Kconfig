## drivers/mtd/nand/spi/Kconfig
```kconfig
menuconfig MTD_SPI_NAND
	tristate "SPI NAND device Support"
	depends on MTD_NAND
	help
	  This is the framework for the SPI NAND device drivers.
```

## drivers/mtd/nand/spi/controllers/Kconfig
```kconfig
config GENERIC_SPI_NAND
	tristate "SPI NAND with generic SPI bus Support"
	depends on MTD_SPI_NAND && SPI
	help
	  This is to support SPI NAND device with generic SPI bus.
```
